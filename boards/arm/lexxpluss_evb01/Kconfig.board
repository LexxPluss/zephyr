## boards/arm/lexxpluss_evb01/Kconfig.board
```kconfig
config BOARD_LEXXPLUSS_EVB01
	bool "LexxPluss Main Control Unit evaluation board"
	depends on SOC_STM32F765XX
```

## boards/arm/lexxpluss_evb01/Kconfig.defconfig
```kconfig
if BOARD_LEXXPLUSS_EVB01

config BOARD
	default "lexxpluss_evb01"

endif # BOARD_LEXXPLUSS_EVB01
```

## boards/arm/lexxpluss_evb01/lexxpluss_evb01_defconfig
```kconfig
CONFIG_SOC_SERIES_STM32F7X=y
CONFIG_SOC_STM32F765XX=y

CONFIG_SYS_CLOCK_HW_CYCLES_PER_SEC=216000000

CONFIG_ARM_MPU=y

CONFIG_HW_STACK_PROTECTION=y

CONFIG_SERIAL=y

CONFIG_CONSOLE=y
CONFIG_UART_CONSOLE=y

CONFIG_PINMUX=y

CONFIG_GPIO=y

CONFIG_CLOCK_CONTROL=y

CONFIG_CLOCK_STM32_HSE_CLOCK=8000000
CONFIG_CLOCK_STM32_SYSCLK_SRC_PLL=y
CONFIG_CLOCK_STM32_PLL_SRC_HSE=y

CONFIG_CLOCK_STM32_PLL_M_DIVISOR=8
CONFIG_CLOCK_STM32_PLL_N_MULTIPLIER=432
CONFIG_CLOCK_STM32_PLL_P_DIVISOR=2
CONFIG_CLOCK_STM32_PLL_Q_DIVISOR=9
CONFIG_CLOCK_STM32_AHB_PRESCALER=1
CONFIG_CLOCK_STM32_APB1_PRESCALER=4
CONFIG_CLOCK_STM32_APB2_PRESCALER=2

CONFIG_LOG=y
```

## boards/arm/lexxpluss_mb01/Kconfig.board
```kconfig
config BOARD_LEXXPLUSS_MB01
	bool "LexxPluss Main Control Unit board"
	depends on SOC_STM32F769XX
```

## boards/arm/lexxpluss_mb01/Kconfig.defconfig
```kconfig
if BOARD_LEXXPLUSS_MB01

config BOARD
	default "lexxpluss_mb01"

endif # BOARD_LEXXPLUSS_MB01
```

## boards/arm/lexxpluss_mb01/lexxpluss_mb01_defconfig
```kconfig
CONFIG_SOC_SERIES_STM32F7X=y
CONFIG_SOC_STM32F769XX=y

CONFIG_ARM_MPU=y

CONFIG_HW_STACK_PROTECTION=y

CONFIG_SERIAL=y

CONFIG_CONSOLE=y
CONFIG_UART_CONSOLE=y

CONFIG_PINMUX=y

CONFIG_GPIO=y
CONFIG_SPI=y

CONFIG_CLOCK_CONTROL=y

CONFIG_LOG=y

CONFIG_LED_STRIP=y
CONFIG_WS2812_STRIP=y
CONFIG_SENSOR=y
CONFIG_MAXBOTIX=n
```

## drivers/sensor/adis16470/Kconfig
```kconfig
menuconfig ADIS16470
	bool "ADIS16470 Driver"
	depends on SPI
	help
	  Enable driver for ADIS16470.

if ADIS16470
endif #ADIS16470
```

## drivers/sensor/maxbotix/Kconfig
```kconfig
# MaxBotix Ultrasonic Ranging Module

menuconfig MAXBOTIX
	bool "MAXBOTIX Ultrasonic Ranging Module"
	help
	  Enable MAXBOTIX ultrasonic distance sensor.

if MAXBOTIX

module = MAXBOTIX
module-str = MAXBOTIX
source "${ZEPHYR_BASE}/subsys/logging/Kconfig.template.log_config"

endif
```

## dts/bindings/sensor/adi,adis16470.yaml
```yaml
description: ADIS16470 sensor

compatible: "adi,adis16470"

include: spi-device.yaml
```

## dts/bindings/sensor/maxbotix,maxbotix.yaml
```yaml
description: MaxBotix Ultrasonic Ranging Module

compatible: "maxbotix,maxbotix"

include: base.yaml

properties:
  label:
    required: true
    type: string
    description: Human readable string describing the device (used as device_get_binding() argument)

  status:
    required: true
    type: string
    description: Human readable string describing the device's status

  trig-gpios:
    type: phandle-array
    description: Trigger pin
    required: true

  echo-gpios:
    type: phandle-array
    description: Echo pin
    required: true
```

## soc/arm/st_stm32/stm32f7/Kconfig.defconfig.stm32f765xx
```kconfig
if SOC_STM32F765XX

config SOC
	default "stm32f765xx"

config NUM_IRQS
	default 110

endif # SOC_STM32F765XX
```
