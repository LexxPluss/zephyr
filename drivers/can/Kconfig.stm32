## drivers/can/Kconfig.stm32
```kconfig
# STM32 CAN configuration options

# Copyright (c) 2018 Alexander Wachter
# SPDX-License-Identifier: Apache-2.0

DT_COMPAT_ST_STM32_CAN := st,stm32-can

config CAN_STM32
	bool "STM32 CAN Driver"
	default $(dt_compat_enabled,$(DT_COMPAT_ST_STM32_CAN))
	help
	  Enable STM32 CAN Driver.
	  Tested on stm32F0, stm32L4 and stm32F7 series.

config CAN_MAX_FILTER
	int "Maximum number of concurrent active filters"
	depends on CAN_STM32
	default 5
	range 1 56
	help
	  Defines the array size of the callback/msgq pointers.
	  Must be at least the size of concurrent reads.

config CAN_STM32_OVERFLOW_DIAG
	bool "STM32 CAN Overflow Diagnostics"
	depends on CAN_STM32
	default n
	help
	  Enable RX FIFO overflow diagnostics for the STM32 CAN driver.
	  When enabled, the driver records RX FIFO overflow statistics that can
	  be queried via the can_get_overflow_diag API, and logs overflow events
	  with rate limiting controlled by CAN_STM32_PROTECTION_PERIOD_MS.

config CAN_STM32_PROTECTION_PERIOD_MS
	int "CAN overflow protection period in milliseconds"
	depends on CAN_STM32_OVERFLOW_DIAG
	default 60000
	help
	  Protection period in milliseconds to avoid CAN overflow log message
	  flooding: during this period, RX FIFO overflow events are counted
	  silently, and after the period expires, each overflow is logged and
	  the protection period restarts.
```
