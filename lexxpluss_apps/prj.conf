## CMakeLists.txt
```
cmake_minimum_required(VERSION 3.13.1)

find_package(Zephyr)
project(lexxpluss_apps)

FILE(GLOB app_sources src/*.cpp)
FILE(GLOB ros_sources LexxAuto/src/arduino/ros_lib/*.cpp)
target_sources(app PRIVATE ${app_sources} ${ros_sources})
target_include_directories(app PRIVATE ${CMAKE_CURRENT_SOURCE_DIR}/LexxAuto/src/arduino/ros_lib)
```

## prj.conf
```kconfig
CONFIG_FPU=y
CONFIG_NEWLIB_LIBC=y
CONFIG_NEWLIB_LIBC_FLOAT_PRINTF=y
CONFIG_CPLUSPLUS=y
CONFIG_STD_CPP17=y
CONFIG_LIB_CPLUSPLUS=y
CONFIG_RTTI=y
CONFIG_RING_BUFFER=y
CONFIG_DISK_ACCESS=y
CONFIG_DISK_DRIVER_SDMMC=y
CONFIG_FILE_SYSTEM=y
CONFIG_FAT_FILESYSTEM_ELM=y
CONFIG_FS_FATFS_LFN=y
```

## src/main.cpp
```c
#include <zephyr.h>
#include <drivers/gpio.h>
#include "actuator_controller.hpp"
#include "adc_reader.hpp"
#include "can_controller.hpp"
#include "imu_controller.hpp"
#include "led_controller.hpp"
#include "misc_controller.hpp"
#include "pgv_controller.hpp"
#include "rosserial.hpp"
#include "tof_controller.hpp"
#include "uss_controller.hpp"

namespace {

K_THREAD_STACK_DEFINE(actuator_controller_stack, 2048);
K_THREAD_STACK_DEFINE(adc_reader_stack, 2048);
K_THREAD_STACK_DEFINE(can_controller_stack, 2048);
K_THREAD_STACK_DEFINE(imu_controller_stack, 2048);
K_THREAD_STACK_DEFINE(led_controller_stack, 2048);
K_THREAD_STACK_DEFINE(misc_controller_stack, 2048);
K_THREAD_STACK_DEFINE(pgv_controller_stack, 2048);
K_THREAD_STACK_DEFINE(rosserial_stack, 2048);
K_THREAD_STACK_DEFINE(tof_controller_stack, 2048);
K_THREAD_STACK_DEFINE(uss_controller_stack, 2048);

#define RUN(name, prio) \
    k_thread_create(&name::thread, name##_stack, K_THREAD_STACK_SIZEOF(name##_stack), \
                    name::run, nullptr, nullptr, nullptr, prio, K_FP_REGS, K_MSEC(2000));

void reset_usb_hub()
{
    const device *gpioa = device_get_binding("GPIOA");
    if (gpioa != nullptr) {
        gpio_pin_configure(gpioa, 3, GPIO_OUTPUT_HIGH | GPIO_ACTIVE_HIGH);
        gpio_pin_set(gpioa, 3, 0);
        k_usleep(200);
        gpio_pin_set(gpioa, 3, 1);
    }
}

}

void main()
{
    reset_usb_hub();
    actuator_controller::init();
    adc_reader::init();
    can_controller::init();
    imu_controller::init();
    led_controller::init();
    misc_controller::init();
    pgv_controller::init();
    rosserial::init();
    tof_controller::init();
    uss_controller::init();
    RUN(actuator_controller, 2);
    RUN(adc_reader, 2);
    RUN(can_controller, 4);
    RUN(imu_controller, 2);
    RUN(led_controller, 2);
    RUN(misc_controller, 2);
    RUN(pgv_controller, 1);
    RUN(tof_controller, 2);
    RUN(uss_controller, 2);
    RUN(rosserial, 3); // The rosserial thread will be started last.
    const device *gpiog = device_get_binding("GPIOG");
    if (gpiog != nullptr)
        gpio_pin_configure(gpiog, 12, GPIO_OUTPUT_LOW | GPIO_ACTIVE_HIGH);
    int heartbeat_led{1};
    while (true) {
        if (gpiog != nullptr) {
            gpio_pin_set(gpiog, 12, heartbeat_led);
            heartbeat_led = !heartbeat_led;
        }
        k_msleep(1000);
    }
}

// vim: set expandtab shiftwidth=4:
```

## src/actuator_controller.cpp
```c
#include <device.h>
#include <drivers/gpio.h>
#include <drivers/pwm.h>
#include "adc_reader.hpp"
#include "actuator_controller.hpp"

k_msgq msgq_actuator2ros;
k_msgq msgq_ros2actuator;

extern "C" void HAL_TIM_Encoder_MspInit(TIM_HandleTypeDef *htim_encoder)
{
    GPIO_InitTypeDef GPIO_InitStruct{0};
    if(htim_encoder->Instance==TIM1) {
        __HAL_RCC_TIM1_CLK_ENABLE();
        __HAL_RCC_GPIOE_CLK_ENABLE();
        GPIO_InitStruct.Pin = GPIO_PIN_9|GPIO_PIN_11;
        GPIO_InitStruct.Mode = GPIO_MODE_AF_PP;
        GPIO_InitStruct.Pull = GPIO_NOPULL;
        GPIO_InitStruct.Speed = GPIO_SPEED_FREQ_LOW;
        GPIO_InitStruct.Alternate = GPIO_AF1_TIM1;
        HAL_GPIO_Init(GPIOE, &GPIO_InitStruct);
    } else if(htim_encoder->Instance==TIM5) {
        __HAL_RCC_TIM5_CLK_ENABLE();
        __HAL_RCC_GPIOH_CLK_ENABLE();
        GPIO_InitStruct.Pin = GPIO_PIN_10|GPIO_PIN_11;
        GPIO_InitStruct.Mode = GPIO_MODE_AF_PP;
        GPIO_InitStruct.Pull = GPIO_NOPULL;
        GPIO_InitStruct.Speed = GPIO_SPEED_FREQ_LOW;
        GPIO_InitStruct.Alternate = GPIO_AF2_TIM5;
        HAL_GPIO_Init(GPIOH, &GPIO_InitStruct);
    } else if(htim_encoder->Instance==TIM8) {
        __HAL_RCC_TIM8_CLK_ENABLE();
        __HAL_RCC_GPIOC_CLK_ENABLE();
        GPIO_InitStruct.Pin = GPIO_PIN_6|GPIO_PIN_7;
        GPIO_InitStruct.Mode = GPIO_MODE_AF_PP;
        GPIO_InitStruct.Pull = GPIO_NOPULL;
        GPIO_InitStruct.Speed = GPIO_SPEED_FREQ_LOW;
        GPIO_InitStruct.Alternate = GPIO_AF3_TIM8;
        HAL_GPIO_Init(GPIOC, &GPIO_InitStruct);
    }
}

namespace {

char __aligned(4) msgq_actuator2ros_buffer[8 * sizeof (msg_actuator2ros)];
char __aligned(4) msgq_ros2actuator_buffer[8 * sizeof (msg_ros2actuator)];

static constexpr uint32_t ACTUATOR_NUM{3};

class timer_hal_helper {
public:
    int init() {
        if (init_tim1() != 0 || init_tim5() != 0 || init_tim8() != 0)
            return -1;
        return 0;
    }
    void get_count(int16_t data[ACTUATOR_NUM]) const {
        data[0] = TIM1->CNT;
        TIM1->CNT = 0;
        data[1] = TIM8->CNT;
        TIM8->CNT = 0;
        data[2] = TIM5->CNT;
        TIM5->CNT = 0;
    }
private:
    int init_tim1() {
        TIM_Encoder_InitTypeDef sConfig{0};
        timh[0].Instance = TIM1;
        timh[0].Init.Prescaler = 0;
        timh[0].Init.CounterMode = TIM_COUNTERMODE_UP;
        timh[0].Init.Period = 65535;
        timh[0].Init.ClockDivision = TIM_CLOCKDIVISION_DIV1;
        timh[0].Init.RepetitionCounter = 0;
        timh[0].Init.AutoReloadPreload = TIM_AUTORELOAD_PRELOAD_DISABLE;
        sConfig.EncoderMode = TIM_ENCODERMODE_TI12;
        sConfig.IC1Polarity = TIM_ICPOLARITY_RISING;
        sConfig.IC1Selection = TIM_ICSELECTION_DIRECTTI;
        sConfig.IC1Prescaler = TIM_ICPSC_DIV1;
        sConfig.IC1Filter = 0b1111;
        sConfig.IC2Polarity = TIM_ICPOLARITY_RISING;
        sConfig.IC2Selection = TIM_ICSELECTION_DIRECTTI;
        sConfig.IC2Prescaler = TIM_ICPSC_DIV1;
        sConfig.IC2Filter = 0b1111;
        if (HAL_TIM_Encoder_Init(&timh[0], &sConfig) != HAL_OK)
            return -1;
        TIM_MasterConfigTypeDef sMasterConfig{0};
        sMasterConfig.MasterOutputTrigger = TIM_TRGO_RESET;
        sMasterConfig.MasterOutputTrigger2 = TIM_TRGO2_RESET;
        sMasterConfig.MasterSlaveMode = TIM_MASTERSLAVEMODE_DISABLE;
        if (HAL_TIMEx_MasterConfigSynchronization(&timh[0], &sMasterConfig) != HAL_OK)
            return -1;
        HAL_TIM_Encoder_Start(&timh[0], TIM_CHANNEL_ALL);
        return 0;
    }
    int init_tim5() {
        TIM_Encoder_InitTypeDef sConfig{0};
        timh[1].Instance = TIM5;
        timh[1].Init.Prescaler = 0;
        timh[1].Init.CounterMode = TIM_COUNTERMODE_UP;
        timh[1].Init.Period = 4294967295;
        timh[1].Init.ClockDivision = TIM_CLOCKDIVISION_DIV1;
        timh[1].Init.AutoReloadPreload = TIM_AUTORELOAD_PRELOAD_DISABLE;
        sConfig.EncoderMode = TIM_ENCODERMODE_TI12;
        sConfig.IC1Polarity = TIM_ICPOLARITY_RISING;
        sConfig.IC1Selection = TIM_ICSELECTION_DIRECTTI;
        sConfig.IC1Prescaler = TIM_ICPSC_DIV1;
        sConfig.IC1Filter = 0b1111;
        sConfig.IC2Polarity = TIM_ICPOLARITY_RISING;
        sConfig.IC2Selection = TIM_ICSELECTION_DIRECTTI;
        sConfig.IC2Prescaler = TIM_ICPSC_DIV1;
        sConfig.IC2Filter = 0b1111;
        if (HAL_TIM_Encoder_Init(&timh[1], &sConfig) != HAL_OK)
            return -1;
        TIM_MasterConfigTypeDef sMasterConfig{0};
        sMasterConfig.MasterOutputTrigger = TIM_TRGO_RESET;
        sMasterConfig.MasterSlaveMode = TIM_MASTERSLAVEMODE_DISABLE;
        if (HAL_TIMEx_MasterConfigSynchronization(&timh[1], &sMasterConfig) != HAL_OK)
            return -1;
        return 0;
    }
    int init_tim8() {
        TIM_Encoder_InitTypeDef sConfig{0};
        timh[2].Instance = TIM8;
        timh[2].Init.Prescaler = 0;
        timh[2].Init.CounterMode = TIM_COUNTERMODE_UP;
        timh[2].Init.Period = 65535;
        timh[2].Init.ClockDivision = TIM_CLOCKDIVISION_DIV1;
        timh[2].Init.RepetitionCounter = 0;
        timh[2].Init.AutoReloadPreload = TIM_AUTORELOAD_PRELOAD_DISABLE;
        sConfig.EncoderMode = TIM_ENCODERMODE_TI12;
        sConfig.IC1Polarity = TIM_ICPOLARITY_RISING;
        sConfig.IC1Selection = TIM_ICSELECTION_DIRECTTI;
        sConfig.IC1Prescaler = TIM_ICPSC_DIV1;
        sConfig.IC1Filter = 0b1111;
        sConfig.IC2Polarity = TIM_ICPOLARITY_RISING;
        sConfig.IC2Selection = TIM_ICSELECTION_DIRECTTI;
        sConfig.IC2Prescaler = TIM_ICPSC_DIV1;
        sConfig.IC2Filter = 0b1111;
        if (HAL_TIM_Encoder_Init(&timh[2], &sConfig) != HAL_OK)
            return -1;
        TIM_MasterConfigTypeDef sMasterConfig{0};
        sMasterConfig.MasterOutputTrigger = TIM_TRGO_RESET;
        sMasterConfig.MasterOutputTrigger2 = TIM_TRGO2_RESET;
        sMasterConfig.MasterSlaveMode = TIM_MASTERSLAVEMODE_DISABLE;
        if (HAL_TIMEx_MasterConfigSynchronization(&timh[2], &sMasterConfig) != HAL_OK)
            return -1;
        return 0;
    }
    TIM_HandleTypeDef timh[ACTUATOR_NUM];
};

class location_calculator {
public:
    location_calculator() {
        mm_per_pulse[0] = 50.0f / 1054.0f;
        mm_per_pulse[1] = 50.0f / 538.0f;
        mm_per_pulse[2] = 50.0f / 538.0f;
    }
    int init() {
        reset();
        return helper.init();
    }
    void reset() {
        for (uint32_t i{0}; i < ACTUATOR_NUM; ++i)
            pulse_value[i] = prev_pulse_value[i] = 0;
    }
    void poll() {
        int16_t d[ACTUATOR_NUM];
        helper.get_count(d);
        for (uint32_t i{0}; i < ACTUATOR_NUM; ++i)
            update_pulse(i, d[i]);
    }
    int32_t get_location(int index) const {
        return static_cast<float>(pulse_value[index]) * mm_per_pulse[index];
    }
    void get_pulse(int32_t value[ACTUATOR_NUM]) const {
        for (uint32_t i{0}; i < ACTUATOR_NUM; ++i)
            value[i] = pulse_value[i];
    }
    void get_delta_pulse(int32_t value[ACTUATOR_NUM]) {
        for (uint32_t i{0}; i < ACTUATOR_NUM; ++i) {
            value[i] = pulse_value[i] - prev_pulse_value[i];
            prev_pulse_value[i] = pulse_value[i];
        }
    }
private:
    void update_pulse(int index, int pulse) {
        pulse_value[index] += -pulse;
    }
    timer_hal_helper helper;
    int32_t pulse_value[ACTUATOR_NUM]{0, 0, 0}, prev_pulse_value[ACTUATOR_NUM]{0, 0, 0};
    float mm_per_pulse[ACTUATOR_NUM];
};

static const struct {
    const char *name;
    uint32_t pin;
} config[ACTUATOR_NUM][2]{
    {{"PWM_12", 1}, {"PWM_2", 3}},
    {{"PWM_14", 1}, {"PWM_4", 1}},
    {{"PWM_3",  3}, {"PWM_9", 1}}
};

class actuator_controller_impl {
public:
    int init() {
        k_msgq_init(&msgq_actuator2ros, msgq_actuator2ros_buffer, sizeof (msg_actuator2ros), 8);
        k_msgq_init(&msgq_ros2actuator, msgq_ros2actuator_buffer, sizeof (msg_ros2actuator), 8);
        prev_cycle = k_cycle_get_32();
        for (uint32_t i{0}; i < ACTUATOR_NUM; ++i) {
            for (uint32_t j{0}; j < 2; ++j) {
                dev_pwm[i][j] = device_get_binding(config[i][j].name);
                if (dev_pwm[i][j] == nullptr)
                    return -1;
            }
        }
        dev_power = device_get_binding("GPIOB");
        dev_fail_01 = device_get_binding("GPIOF");
        dev_fail_2 = device_get_binding("GPIOJ");
        if (dev_power == nullptr || dev_fail_01 == nullptr || dev_fail_2 == nullptr)
            return -1;
        gpio_pin_configure(dev_power, 1, GPIO_OUTPUT_HIGH | GPIO_ACTIVE_HIGH);
        gpio_pin_configure(dev_fail_01, 11, GPIO_INPUT | GPIO_ACTIVE_HIGH);
        gpio_pin_configure(dev_fail_01, 12, GPIO_INPUT | GPIO_ACTIVE_HIGH);
        gpio_pin_configure(dev_fail_2, 4, GPIO_INPUT | GPIO_ACTIVE_HIGH);
        k_mutex_init(&service_mutex);
        return calculator.init();
    }
    void run() {
        for (uint32_t i{0}; i < ACTUATOR_NUM; ++i) {
            for (uint32_t j{0}; j < 2; ++j) {
                if (!device_is_ready(dev_pwm[i][j]))
                    return;
                pwm_pin_set_nsec(dev_pwm[i][j], config[i][j].pin, CONTROL_PERIOD_NS, 0, PWM_POLARITY_NORMAL);
            }
        }
        wait_encoder_stabilize();
        const device *gpiok = device_get_binding("GPIOK");
        if (gpiok != nullptr)
            gpio_pin_configure(gpiok, 4, GPIO_OUTPUT_LOW | GPIO_ACTIVE_HIGH);
        int heartbeat_led{1};
        while (true) {
            msg_ros2actuator message;
            if (k_msgq_get(&msgq_ros2actuator, &message, K_NO_WAIT) == 0)
                handle_control(message);
            calculator.poll();
            uint32_t now_cycle{k_cycle_get_32()};
            uint32_t dt_ms{k_cyc_to_ms_near32(now_cycle - prev_cycle)};
            if (dt_ms > 100) {
                prev_cycle = now_cycle;
                calculator.get_pulse(actuator2ros.encoder_count);
                get_current(actuator2ros.current);
                actuator2ros.connect = get_trolley();
                get_fail(actuator2ros.fail);
                while (k_msgq_put(&msgq_actuator2ros, &actuator2ros, K_NO_WAIT) != 0)
                    k_msgq_purge(&msgq_actuator2ros);
                if (gpiok != nullptr) {
                    gpio_pin_set(gpiok, 4, heartbeat_led);
                    heartbeat_led = !heartbeat_led;
                }
            }
            k_msleep(10);
        }
    }
    void wait_encoder_stabilize() {
        for (int i{0}; i < 10; ++i) {
            int32_t value[ACTUATOR_NUM];
            calculator.poll();
            calculator.get_delta_pulse(value);
            if (value[0] == 0 && value[1] == 0 && value[2] == 0)
                break;
            k_msleep(100);
        }
        calculator.reset();
    }
    int init_location() {
        location_initialized = false;
        if (k_mutex_lock(&service_mutex, K_MSEC(30000)) != 0)
            return -1;
        pwm_control_all(msg_ros2actuator::DOWN, 100);
        static constexpr uint32_t timeout_ms{30000}, sleep_ms{500};
        int remaining{3};
        for (uint32_t i{0}, end{timeout_ms / sleep_ms}; i < end; ++i) {
            int32_t value[ACTUATOR_NUM];
            calculator.get_delta_pulse(value);
            remaining = 3;
            for (uint32_t j{0}; j < ACTUATOR_NUM; ++j) {
                if (i >= 2 && value[j] == 0) {
                    pwm_control(j, msg_ros2actuator::STOP, 0);
                    --remaining;
                }
            }
            if (remaining <= 0)
                break;
            k_msleep(sleep_ms);
        }
        pwm_control_all(msg_ros2actuator::STOP);
        k_mutex_unlock(&service_mutex);
        calculator.reset();
        if (remaining <= 0) {
            location_initialized = true;
            return 0;
        } else {
            return -1;
        }
    }
    int to_location(const uint8_t location[ACTUATOR_NUM], const uint8_t power[ACTUATOR_NUM], uint8_t detail[ACTUATOR_NUM]) {
        if (!location_initialized) {
            for (uint32_t i{0}; i < ACTUATOR_NUM; ++i)
                detail[i] = 3;
            return -1;
        }
        if (k_mutex_lock(&service_mutex, K_MSEC(30000)) != 0)
            return -1;
        int direction[ACTUATOR_NUM];
        for (uint32_t i{0}; i < ACTUATOR_NUM; ++i) {
            if (power[i] != 0) {
                int32_t diff{static_cast<int32_t>(location[i]) - calculator.get_location(i)};
                direction[i] = diff < 0 ? msg_ros2actuator::DOWN : msg_ros2actuator::UP;
                pwm_control(i, direction[i], power[i]);
                detail[i] = 1;
            } else {
                direction[i] = msg_ros2actuator::STOP;
                detail[i] = 0;
            }
        }
        static constexpr uint32_t timeout_ms{30000}, sleep_ms{20};
        int remaining{3};
        for (uint32_t i{0}, end{timeout_ms / sleep_ms}; i < end; ++i) {
            int32_t value[ACTUATOR_NUM];
            calculator.get_delta_pulse(value);
            remaining = 3;
            for (uint32_t j{0}; j < ACTUATOR_NUM; ++j) {
                int32_t diff{static_cast<int32_t>(location[j]) - calculator.get_location(j)};
                if ((direction[j] == msg_ros2actuator::DOWN && diff >= 0) ||
                    (direction[j] == msg_ros2actuator::UP   && diff <= 0) ||
                    (direction[j] != msg_ros2actuator::STOP && i >= 5 && value[j] == 0)) {
                    direction[j] = msg_ros2actuator::STOP;
                    pwm_control(j, msg_ros2actuator::STOP, 0);
                    detail[j] = 0;
                    --remaining;
                } else if (direction[j] == msg_ros2actuator::STOP) {
                    --remaining;
                }
            }
            if (remaining <= 0)
                break;
            k_msleep(sleep_ms);
        }
        pwm_control_all(msg_ros2actuator::STOP);
        k_mutex_unlock(&service_mutex);
        return remaining <= 0 ? 0 : -1;
    }
private:
    void handle_control(const msg_ros2actuator &msg) {
        if (k_mutex_lock(&service_mutex, K_MSEC(10)) != 0)
            return;
        for (uint32_t i{0}; i < ACTUATOR_NUM; ++i)
            pwm_control(i, msg.actuators[i].direction, msg.actuators[i].power);
        k_mutex_unlock(&service_mutex);
    }
    void pwm_control_all(int direction, uint8_t pwm_duty = 0) const {
        for (uint32_t i{0}; i < ACTUATOR_NUM; ++i)
            pwm_control(i, direction, pwm_duty);
    }
    void pwm_control(int index, int direction, uint8_t pwm_duty) const {
        if (direction == msg_ros2actuator::STOP || pwm_duty == 0) {
            for (uint32_t i{0}; i < 2; ++i)
                pwm_pin_set_nsec(dev_pwm[index][i], config[index][i].pin, CONTROL_PERIOD_NS, 0, PWM_POLARITY_NORMAL);
        } else {
            uint32_t pulse_ns{pwm_duty * CONTROL_PERIOD_NS / 100};
            if (direction < msg_ros2actuator::STOP) {
                pwm_pin_set_nsec(dev_pwm[index][0], config[index][0].pin, CONTROL_PERIOD_NS, 0, PWM_POLARITY_NORMAL);
                pwm_pin_set_nsec(dev_pwm[index][1], config[index][1].pin, CONTROL_PERIOD_NS, pulse_ns, PWM_POLARITY_NORMAL);
            } else {
                pwm_pin_set_nsec(dev_pwm[index][0], config[index][0].pin, CONTROL_PERIOD_NS, pulse_ns, PWM_POLARITY_NORMAL);
                pwm_pin_set_nsec(dev_pwm[index][1], config[index][1].pin, CONTROL_PERIOD_NS, 0, PWM_POLARITY_NORMAL);
            }
        }
    }
    void get_current(int32_t data[ACTUATOR_NUM]) const {
        data[0] = adc_reader::get(adc_reader::INDEX_ACTUATOR_0);
        data[1] = adc_reader::get(adc_reader::INDEX_ACTUATOR_1);
        data[2] = adc_reader::get(adc_reader::INDEX_ACTUATOR_2);
    }
    int32_t get_trolley() const {
        return adc_reader::get(adc_reader::INDEX_TROLLEY);
    }
    void get_fail(bool fail[ACTUATOR_NUM]) const {
        fail[0] = gpio_pin_get(dev_fail_01, 11) == 0;
        fail[1] = gpio_pin_get(dev_fail_01, 12) == 0;
        fail[2] = gpio_pin_get(dev_fail_2, 4) == 0;
    }
    location_calculator calculator;
    msg_actuator2ros actuator2ros;
    k_mutex service_mutex;
    uint32_t prev_cycle{0};
    bool location_initialized{false};
    const device *dev_pwm[ACTUATOR_NUM][2]{{nullptr, nullptr}, {nullptr, nullptr}, {nullptr, nullptr}};
    const device *dev_power{nullptr}, *dev_fail_01{nullptr}, *dev_fail_2{nullptr};
    static constexpr uint32_t CONTROL_HZ{5000};
    static constexpr uint32_t CONTROL_PERIOD_NS{1000000000ULL / CONTROL_HZ};
} impl;

}

void actuator_controller::init()
{
    impl.init();
}

void actuator_controller::run(void *p1, void *p2, void *p3)
{
    impl.run();
}

int actuator_controller::init_location()
{
    return impl.init_location();
}

int actuator_controller::to_location(const uint8_t location[ACTUATOR_NUM], const uint8_t power[ACTUATOR_NUM], uint8_t detail[ACTUATOR_NUM])
{
    return impl.to_location(location, power, detail);
}

k_thread actuator_controller::thread;

// vim: set expandtab shiftwidth=4:
```

## src/actuator_controller.hpp
```c
#pragma once

#include <zephyr.h>

struct msg_ros2actuator {
    struct {
        int8_t direction;
        uint8_t power;
    } actuators[3];
    static constexpr int8_t DOWN{-1}, STOP{0}, UP{1};
} __attribute__((aligned(4)));

struct msg_actuator2ros {
    int32_t encoder_count[3];
    int32_t current[3];
    int32_t connect;
    bool fail[3];
} __attribute__((aligned(4)));

struct actuator_controller {
    static void init();
    static void run(void *p1, void *p2, void *p3);
    static k_thread thread;
};

extern k_msgq msgq_actuator2ros;
extern k_msgq msgq_ros2actuator;

// vim: set expandtab shiftwidth=4:
```

## src/actuator_controller_ng.cpp
```c
#include <device.h>
#include <drivers/pwm.h>
#include "actuator_controller.hpp"

namespace {

static constexpr uint32_t ACTUATOR_NUM{3};

class actuator_driver_pin {
public:
    struct config {
        const char *name;
        uint32_t pin;
    };
    int init(const config &data) {
        dev = device_get_binding(data.name);
        pin = data.pin;
        return dev == nullptr ? -1 : 0;
    }
    bool ready() const {
        return device_is_ready(dev);
    }
    void H() const {
        pwm_pin_set_nsec(dev, pin, CONTROL_PERIOD_NS, CONTROL_PERIOD_NS, PWM_POLARITY_NORMAL);
    }
private:
    uint32_t pin{0};
    const device *dev{nullptr};
    static constexpr uint32_t CONTROL_HZ{5000};
    static constexpr uint32_t CONTROL_PERIOD_NS{1000000000ULL / CONTROL_HZ};
};

class actuator_driver {
public:
    int init(const actuator_driver_pin::config (&data)[2]) {
        for (int i{0}; i < 2; ++i) {
            if (pin[i].init(data[i]) != 0)
                return -1;
        }
        return 0;
    }
    void run() {
        for (const auto &i : pin) {
            if (!i.ready())
                return;
        }
    }
private:
    void stop() const {
        for (const auto &i : pin)
            i.H();
    }
    actuator_driver_pin pin[2];
} driver[ACTUATOR_NUM];

}

void a()
{
    actuator_driver_pin::config data[]{{"a", 1}, {"b", 2}};
    driver[0].init(data);
}

// vim: set expandtab shiftwidth=4:
```

## src/adc_reader.cpp
```c
#include <device.h>
#include <drivers/adc.h>
#include "adc_reader.hpp"

namespace {

class adc_reader_impl {
public:
    int init() {
        dev = device_get_binding("ADC_1");
        return dev == nullptr ? -1 : 0;
    }
    void run() {
        if (!device_is_ready(dev))
            return;
        while (true) {
            read_all_channels();
            k_msleep(20);
        }
    }
    int32_t get(int index) const {
        int32_t ref{adc_ref_internal(dev)};
        int32_t value{buffer[index]};
        if (ref > 0)
            adc_raw_to_millivolts(ref, ADC_GAIN_1, 12, &value);
        return value;
    }
private:
    void read_all_channels() {
        static constexpr uint8_t ch[NUM_CHANNELS]{0, 1, 10, 11, 12, 13};
        for (int i{0}; i < NUM_CHANNELS; ++i) {
            // Only single channel supported
            adc_channel_cfg channel_cfg{
                .gain{ADC_GAIN_1},
                .reference{ADC_REF_INTERNAL},
                .acquisition_time{ADC_ACQ_TIME_DEFAULT},
                .channel_id = ch[i],
                .differential{0}
            };
            adc_channel_setup(dev, &channel_cfg);
            adc_sequence sequence{
                .options{nullptr},
                .channels{BIT(ch[i])},
                .buffer{&buffer[i]},
                .buffer_size{sizeof buffer[i]},
                .resolution{12},
                .oversampling{0},
                .calibrate{0}
            };
            adc_read(dev, &sequence);
        }
    }
    static constexpr int NUM_CHANNELS{6};
    const device *dev{nullptr};
    uint16_t buffer[NUM_CHANNELS];
} impl;

}

void adc_reader::init()
{
    impl.init();
}

void adc_reader::run(void *p1, void *p2, void *p3)
{
    impl.run();
}

int32_t adc_reader::get(int index)
{
    return impl.get(index);
}

k_thread adc_reader::thread;

// vim: set expandtab shiftwidth=4:
```

## src/adc_reader.hpp
```c
#pragma once

#include <zephyr.h>

struct adc_reader {
    static void init();
    static void run(void *p1, void *p2, void *p3);
    static int32_t get(int index);
    static k_thread thread;
    static constexpr int INDEX_DOWNWARD_L{0};
    static constexpr int INDEX_DOWNWARD_R{1};
    static constexpr int INDEX_ACTUATOR_0{2};
    static constexpr int INDEX_ACTUATOR_1{3};
    static constexpr int INDEX_ACTUATOR_2{4};
    static constexpr int INDEX_TROLLEY{5};
};

// vim: set expandtab shiftwidth=4:
```

## src/can_controller.cpp
```c
#include <zephyr.h>
#include <device.h>
#include <drivers/can.h>
#include <drivers/gpio.h>
#include "can_controller.hpp"
#include "misc_controller.hpp"

k_msgq msgq_bmu2ros;
k_msgq msgq_board2ros;
k_msgq msgq_ros2board;

namespace {

char __aligned(4) msgq_bmu2ros_buffer[8 * sizeof (msg_bmu2ros)];
char __aligned(4) msgq_board2ros_buffer[8 * sizeof (msg_board2ros)];
char __aligned(4) msgq_ros2board_buffer[8 * sizeof (msg_ros2board)];

CAN_DEFINE_MSGQ(msgq_can_bmu, 16);
CAN_DEFINE_MSGQ(msgq_can_board, 4);
CAN_DEFINE_MSGQ(msgq_can_log, 8);

class log_printer {
public:
    void putc(char c) {
        buffer[index++] = c;
        if (c == '\n' || index >= 80) {
            buffer[index] = '\0';
            printk("%s", buffer);
            index = 0;
        }
    }
private:
    uint32_t index{0};
    char buffer[128];
};

class can_controller_impl {
public:
    int init() {
        k_msgq_init(&msgq_bmu2ros, msgq_bmu2ros_buffer, sizeof (msg_bmu2ros), 8);
        k_msgq_init(&msgq_board2ros, msgq_board2ros_buffer, sizeof (msg_board2ros), 8);
        k_msgq_init(&msgq_ros2board, msgq_ros2board_buffer, sizeof (msg_ros2board), 8);
        dev = device_get_binding("CAN_1");
        if (dev != nullptr)
            can_configure(dev, CAN_NORMAL_MODE, 500000);
        return dev == nullptr ? -1 : 0;
    }
    void run() {
        if (!device_is_ready(dev))
            return;
        const device *gpiok = device_get_binding("GPIOK");
        if (gpiok != nullptr)
            gpio_pin_configure(gpiok, 3, GPIO_OUTPUT_LOW | GPIO_ACTIVE_HIGH);
        setup_can_filter();
        int heartbeat_led{1};
        while (true) {
            bool handled{false};
            zcan_frame frame;
            if (k_msgq_get(&msgq_can_bmu, &frame, K_NO_WAIT) == 0) {
                if (handler_bmu(frame)) {
                    while (k_msgq_put(&msgq_bmu2ros, &bmu2ros, K_NO_WAIT) != 0)
                        k_msgq_purge(&msgq_bmu2ros);
                }
                handled = true;
            }
            if (k_msgq_get(&msgq_can_board, &frame, K_NO_WAIT) == 0) {
                handler_board(frame);
                while (k_msgq_put(&msgq_board2ros, &board2ros, K_NO_WAIT) != 0)
                    k_msgq_purge(&msgq_board2ros);
                handled = true;
            }
            if (k_msgq_get(&msgq_can_log, &frame, K_NO_WAIT) == 0)
                handler_log(frame);
            if (k_msgq_get(&msgq_ros2board, &ros2board, K_NO_WAIT) == 0) {
                prev_cycle_ros = k_cycle_get_32();
                handled = true;
            }
            uint32_t now_cycle{k_cycle_get_32()};
            if (prev_cycle_ros != 0) {
                uint32_t dt_ms{k_cyc_to_ms_near32(now_cycle - prev_cycle_ros)};
                heartbeat_timeout = dt_ms > 1000;
            }
            uint32_t dt_ms{k_cyc_to_ms_near32(now_cycle - prev_cycle_send)};
            if (dt_ms > 100) {
                prev_cycle_send = now_cycle;
                send_message();
                if (gpiok != nullptr) {
                    gpio_pin_set(gpiok, 3, heartbeat_led);
                    heartbeat_led = !heartbeat_led;
                }
            }
            if (!handled)
                k_msleep(1);
        }
    }
    uint32_t get_rsoc() const {
        return bmu2ros.rsoc;
    }
private:
    void setup_can_filter() const {
        static const zcan_filter filter_bmu{
            .id{0x100},
            .rtr{CAN_DATAFRAME},
            .id_type{CAN_STANDARD_IDENTIFIER},
            .id_mask{0x1c0},
            .rtr_mask{1}
        };
        static const zcan_filter filter_board{
            .id{0x200},
            .rtr{CAN_DATAFRAME},
            .id_type{CAN_STANDARD_IDENTIFIER},
            .id_mask{CAN_STD_ID_MASK},
            .rtr_mask{1}
        };
        static const zcan_filter filter_log{
            .id{0x300},
            .rtr{CAN_DATAFRAME},
            .id_type{CAN_STANDARD_IDENTIFIER},
            .id_mask{CAN_STD_ID_MASK},
            .rtr_mask{1}
        };
        can_attach_msgq(dev, &msgq_can_bmu, &filter_bmu);
        can_attach_msgq(dev, &msgq_can_board, &filter_board);
        can_attach_msgq(dev, &msgq_can_log, &filter_log);
    }
    bool handler_bmu(zcan_frame &frame) {
        bool result{false};
        if (frame.id == 0x100) {
            bmu2ros.mod_status1 = frame.data[0];
            bmu2ros.bmu_status = frame.data[1];
            bmu2ros.asoc = frame.data[2];
            bmu2ros.rsoc = frame.data[3];
            bmu2ros.soh = frame.data[4];
            bmu2ros.fet_temp = (frame.data[5] << 8) | frame.data[6];
        } else if (frame.id == 0x101) {
            bmu2ros.pack_current = (frame.data[0] << 8) | frame.data[1];
            bmu2ros.charging_current = (frame.data[2] << 8) | frame.data[3];
            bmu2ros.pack_voltage = (frame.data[4] << 8) | frame.data[5];
            bmu2ros.mod_status2 = frame.data[6];
        } else if (frame.id == 0x103) {
            bmu2ros.design_capacity = (frame.data[0] << 8) | frame.data[1];
            bmu2ros.full_charge_capacity = (frame.data[2] << 8) | frame.data[3];
            bmu2ros.remain_capacity = (frame.data[4] << 8) | frame.data[5];
        } else if (frame.id == 0x110) {
            bmu2ros.max_voltage.value = (frame.data[0] << 8) | frame.data[1];
            bmu2ros.max_voltage.id = frame.data[2];
            bmu2ros.min_voltage.value = (frame.data[4] << 8) | frame.data[5];
            bmu2ros.min_voltage.id = frame.data[6];
        } else if (frame.id == 0x111) {
            bmu2ros.max_temp.value = (frame.data[0] << 8) | frame.data[1];
            bmu2ros.max_temp.id = frame.data[2];
            bmu2ros.min_temp.value = (frame.data[4] << 8) | frame.data[5];
            bmu2ros.min_temp.id = frame.data[6];
        } else if (frame.id == 0x112) {
            bmu2ros.max_current.value = (frame.data[0] << 8) | frame.data[1];
            bmu2ros.max_current.id = frame.data[2];
            bmu2ros.min_current.value = (frame.data[4] << 8) | frame.data[5];
            bmu2ros.min_current.id = frame.data[6];
        } else if (frame.id == 0x113) {
            bmu2ros.bmu_fw_ver = frame.data[0];
            bmu2ros.mod_fw_ver = frame.data[1];
            bmu2ros.serial_config = frame.data[2];
            bmu2ros.parallel_config = frame.data[3];
            bmu2ros.bmu_alarm1 = frame.data[4];
            bmu2ros.bmu_alarm2 = frame.data[5];
        } else if (frame.id == 0x120) {
            bmu2ros.min_cell_voltage.value = (frame.data[0] << 8) | frame.data[1];
            bmu2ros.min_cell_voltage.id = frame.data[2];
            bmu2ros.max_cell_voltage.value = (frame.data[4] << 8) | frame.data[5];
            bmu2ros.max_cell_voltage.id = frame.data[6];
        } else if (frame.id == 0x130) {
            bmu2ros.manufacturing = (frame.data[0] << 8) | frame.data[1];
            bmu2ros.inspection = (frame.data[2] << 8) | frame.data[3];
            bmu2ros.serial = (frame.data[4] << 8) | frame.data[5];
            result = true;
        }
        return result;
    }
    void handler_board(zcan_frame &frame) {
        board2ros.bumper_switch[0] = (frame.data[0] & 0b00001000) != 0;
        board2ros.bumper_switch[1] = (frame.data[0] & 0b00010000) != 0;
        board2ros.emergency_switch[0] = (frame.data[0] & 0b00000010) != 0;
        board2ros.emergency_switch[1] = (frame.data[0] & 0b00000100) != 0;
        board2ros.power_switch = (frame.data[0] & 0b00000001) != 0;
        board2ros.auto_charging = (frame.data[1] & 0b00000010) != 0;
        board2ros.manual_charging = (frame.data[1] & 0b00000001) != 0;
        board2ros.c_fet = (frame.data[2] & 0b00010000) != 0;
        board2ros.d_fet = (frame.data[2] & 0b00100000) != 0;
        board2ros.p_dsg = (frame.data[2] & 0b01000000) != 0;
        board2ros.v5_fail = (frame.data[2] & 0b00000001) != 0;
        board2ros.v16_fail = (frame.data[2] & 0b00000010) != 0;
        board2ros.wheel_disable[0] = (frame.data[3] & 0b00000001) != 0;
        board2ros.wheel_disable[1] = (frame.data[3] & 0b00000010) != 0;
        board2ros.fan_duty = frame.data[4];
        board2ros.charge_connector_temp[0] = frame.data[5];
        board2ros.charge_connector_temp[1] = frame.data[6];
        board2ros.power_board_temp = frame.data[7];
        board2ros.main_board_temp = misc_controller::get_main_board_temp();
        for (auto i{0}; i < 3; ++i)
            board2ros.actuator_board_temp[i] = misc_controller::get_actuator_board_temp(i);
    }
    void handler_log(zcan_frame &frame) {
        for (uint32_t i{0}; i < frame.dlc; ++i) {
            uint8_t data{frame.data[i]};
            if (data == 0)
                break;
            log.putc(data);
        }
    }
    void send_message() const {
        zcan_frame frame{
            .id{0x201},
            .rtr{CAN_DATAFRAME},
            .id_type{CAN_STANDARD_IDENTIFIER},
            .dlc{3},
            .data{ros2board.emergency_stop, ros2board.power_off, heartbeat_timeout}
        };
        can_send(dev, &frame, K_MSEC(100), nullptr, nullptr);
    }
    msg_bmu2ros bmu2ros{0};
    msg_board2ros board2ros{0};
    msg_ros2board ros2board{true, false};
    log_printer log;
    uint32_t prev_cycle_ros{0}, prev_cycle_send{0};
    const device *dev{nullptr};
    bool heartbeat_timeout{true};
} impl;

}

void can_controller::init()
{
    impl.init();
}

void can_controller::run(void *p1, void *p2, void *p3)
{
    impl.run();
}

uint32_t can_controller::get_rsoc()
{
    return impl.get_rsoc();
}

k_thread can_controller::thread;

// vim: set expandtab shiftwidth=4:
```

## src/can_controller.hpp
```c
#pragma once

#include <zephyr.h>

struct msg_bmu2ros {
    struct {
        uint16_t value;
        uint8_t id;
    } max_voltage, min_voltage, max_cell_voltage, min_cell_voltage;
    struct {
        int16_t value;
        uint8_t id;
    } max_temp, min_temp, max_current, min_current;
    int16_t fet_temp, pack_current;
    uint16_t charging_current, pack_voltage, design_capacity, full_charge_capacity, remain_capacity;
    uint16_t manufacturing, inspection, serial;
    uint8_t mod_status1, mod_status2, bmu_status, asoc, rsoc, soh;
    uint8_t bmu_fw_ver, mod_fw_ver, serial_config, parallel_config, bmu_alarm1, bmu_alarm2;
} __attribute__((aligned(4)));

struct msg_board2ros {
    int16_t charge_connector_temp[2], power_board_temp, main_board_temp, actuator_board_temp;
    uint8_t fan_duty;
    bool bumper_switch[2];
    bool emergency_switch[2];
    bool power_switch, auto_charging, manual_charging;
    bool c_fet, d_fet, p_dsg, v5_fail, v16_fail;
    bool wheel_disable[2];
} __attribute__((aligned(4)));

struct msg_ros2board {
    bool emergency_stop, power_off;
} __attribute__((aligned(4)));

struct can_controller {
    static void init();
    static void run(void *p1, void *p2, void *p3);
    static k_thread thread;
};

extern k_msgq msgq_bmu2ros;
extern k_msgq msgq_board2ros;
extern k_msgq msgq_ros2board;

// vim: set expandtab shiftwidth=4:
```

## src/commander.cpp
```c
#include <zephyr.h>
#include <device.h>
#include <devicetree.h>
#include <drivers/gpio.h>
#include "thread_runner.hpp"

namespace {

#define LED   DT_ALIAS(led1)
#define LABEL DT_GPIO_LABEL(LED, gpios)
#define PIN   DT_GPIO_PIN(LED, gpios)
#define FLAG  DT_GPIO_FLAGS(LED, gpios)

class commander {
public:
    int setup() {
        dev = device_get_binding(LABEL);
        if (dev)
            gpio_pin_configure(dev, PIN, GPIO_OUTPUT_ACTIVE | FLAG);
        return dev == nullptr ? -1 : 0;
    }
    void loop() const {
        gpio_pin_set(dev, PIN, 1);
        k_msleep(400);
        gpio_pin_set(dev, PIN, 0);
        k_msleep(400);
    }
private:
    const device *dev = nullptr;
};

LEXX_THREAD_RUNNER(commander);

}
```

## src/commander.hpp
```c
#pragma once

class commander {
public:
    int init();
    void run();
private:
};
```

## src/data_validator.hpp
```c
#pragma once

#include <cfloat>
#include <cmath>

template <typename T, uint32_t N>
class validator_base {
public:
    void put(T *data) {
        for (uint32_t i{0}; i < N; ++i) {
            if (value[i] == data[i])
                ++equal_count;
            else
                equal_count = 0;
            value[i] = data[i];
        }
    }
    T get(uint32_t index = 0) const {
        return value[index];
    }
    bool is_low_confidence() const {
        return confidence() < 0.5f;
    }
    uint32_t equal_count{0};
    static constexpr uint32_t MAX_EQUAL_COUNT{100};
protected:
    float confidence() const {
        float result{1.0f};
        if (equal_count > MAX_EQUAL_COUNT)
            result = 0.0f;
        return result;
    }
    T value[N]{0};
};

template <typename T, uint32_t N>
struct data_validator : public validator_base<T, N> {
};

template <typename T>
class data_validator<T, 1> : public validator_base<T, 1> {
public:
    void put(T val) {
        parent::put(&val);
    }
private:
    typedef validator_base<T, 1> parent;
};

template <uint32_t N>
class data_validator<float, N> : public validator_base<float, N> {
public:
    void put(float *data) {
        for (uint32_t i{0}; i < N; ++i) {
            if (fabsf(parent::value[i] - data[i]) < FLT_EPSILON)
                ++parent::equal_count;
            else
                parent::equal_count = 0;
            parent::value[i] = data[i];
        }
    }
private:
    typedef validator_base<float, N> parent;
};

template <>
class data_validator<float, 1> : public validator_base<float, 1> {
public:
    void put(float val) {
        parent::put(&val);
    }
private:
    typedef validator_base<float, 1> parent;
};

// vim: set expandtab shiftwidth=4:
```

## src/failsafe_manager.cpp
```c
#include <zephyr.h>
#include "thread_runner.hpp"

namespace {

class failsafe_manager {
public:
    int setup() const {
        return 0;
    }
    void loop() const {
        k_msleep(1000);
    }
};

LEXX_THREAD_RUNNER(failsafe_manager);

}
```

## src/failsafe_manager.hpp
```c
#pragma once

class failsafe_manager {
public:
    int init();
    void run();
private:
};
```
